## testing code/VSCode/rotating_LED/main/Kconfig.projbuild
```kconfig
menu "blink configuration"
    
    orsource "$IDF_PATH/examples/common_components/env_caps/$IDF_TARGET/Kconfig.env_caps"
    
    config BLINK_PERIOD
        int "Blink period in ms"
        range 10 3600000
        default 1000
        help
            define the blinking period in ms
endmenu
```
